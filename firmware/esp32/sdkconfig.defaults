## firmware/esp32/sdkconfig.defaults
```kconfig
CONFIG_MICRO_ROS_ESP_UART_TRANSPORT=y
CONFIG_ESP_CONSOLE_NONE=y
CONFIG_LOG_DEFAULT_LEVEL_NONE=y
CONFIG_BOOTLOADER_LOG_LEVEL_NONE=y
CONFIG_FREERTOS_HZ=1000
```
